## software/battery_management_system/Kconfig
```kconfig
source "Kconfig.zephyr"

menu "battery management system"

menuconfig BATTERY_MANAGEMENT_SYSTEM_LOG
	bool "Enable battery management system logging and debugging"
	select LOG
	help
	  Enable logging of battery management system

module = BATTERY_MANAGEMENT_SYSTEM
module-dep = BATTERY_MANAGEMENT_SYSTEM_LOG
module-str = Log level for battery management system
module-help = Enables log levels for battery management system
source "subsys/net/Kconfig.template.log_config.net"

menuconfig STATUS_LEDS
	bool "status leds"
	default y
	depends on DT_HAS_BENEDIKTIBK_STATUS_LEDS_ENABLED

config STATUS_LEDS_POST_KERNEL_INIT_PRIORITY
	int "initialization priority for status leds"
	default 80
	depends on STATUS_LEDS

menuconfig CELL_VOLTAGE
	bool "cell voltage"
	default y
	depends on DT_HAS_BENEDIKTIBK_CELL_VOLTAGE_ENABLED

config CELL_VOLTAGE_POST_KERNEL_INIT_PRIORITY
	int "initialization priority for cell voltage"
	default 80
	depends on CELL_VOLTAGE

menuconfig CELLS_MEASUREMENT
	bool "cells measurement"
	default y
	depends on DT_HAS_BENEDIKTIBK_CELLS_MEASUREMENT_ENABLED

config CELLS_MEASUREMENT_POST_KERNEL_INIT_PRIORITY
	int "initialization priority for cells measurement"
	default 80
	depends on CELLS_MEASUREMENT

menuconfig POWER_CONTROL
	bool "power control"
	default y
	depends on DT_HAS_BENEDIKTIBK_POWER_CONTROL_ENABLED

config POWER_CONTROL_POST_KERNEL_INIT_PRIORITY
	int "initialization priority for power control"
	default 80
	depends on POWER_CONTROL

menuconfig CELL_BALANCER
	bool "cell balancer"
	default y
	depends on DT_HAS_BENEDIKTIBK_CELL_BALANCER_ENABLED

config CELL_BALANCER_POST_KERNEL_INIT_PRIORITY
	int "initialization priority for cell balancer"
	default 80
	depends on CELL_BALANCER

config BMS_LOOP_TIME_MS
	int "loop time for BMS in ms"

config MAXIMUM_BMS_PCB_TEMPERATURE_CELSIUS
	int "maximum BMS PCB temperature in degree celsius"

endmenu
```

## software/battery_management_system/dts/bindings/benediktibk,cell-balancer.yaml
```yaml
description: Cell Balancer

compatible: "benediktibk,cell-balancer"

include: ["base.yaml"]

properties:
  enable-gpios:
    type: phandle-array
    required: true
    description: enable GPIO

  cell-select-a0-gpios:
    type: phandle-array
    required: true
    description: cell select A0 GPIO

  cell-select-a1-gpios:
    type: phandle-array
    required: true
    description: cell select A1 GPIO
  
  pwm:
    type: phandle
    required: true
    description: PWM device
  
  pwm-channel:
    type: int
    required: true
    description: PWM channel
```

## software/battery_management_system/dts/bindings/benediktibk,cell-voltage.yaml
```yaml
description: Cell Voltage Measurement

compatible: "benediktibk,cell-voltage"

include: ["base.yaml"]

properties:
  adc:
    type: phandle
    required: true
    description: ADC device
  
  adc-channel:
    type: int
    required: true
    description: ADC channel index
  
  voltage-divider-upper:
    type: int
    required: true
    description: upper value of voltage divider
  
  voltage-divider-lower:
    type: int
    required: true
    description: lower value of voltage divider
```

## software/battery_management_system/dts/bindings/benediktibk,cells-measurement.yaml
```yaml
description: Cells Measurement

compatible: "benediktibk,cells-measurement"

include: ["base.yaml"]

properties:
  enable-gpios:
    type: phandle-array
    required: true
    description: enable GPIO

  cell-voltages:
    type: phandles
    required: true
    description: cell voltage measurement devices
```

## software/battery_management_system/dts/bindings/benediktibk,power-control.yaml
```yaml
description: Power Control

compatible: "benediktibk,power-control"

include: ["base.yaml"]

properties:
  charge-gpios:
    type: phandle-array
    required: true
    description: charge GPIO
  
  discharge-gpios:
    type: phandle-array
    required: true
    description: discharge GPIO
  
  charge-available-gpios:
    type: phandle-array
    required: true
    description: charge available GPIO
```

## software/battery_management_system/dts/bindings/benediktibk,status-leds.yaml
```yaml
description: Status Leds

compatible: "benediktibk,status-leds"

include: ["base.yaml"]

properties:
  system-active-gpios:
    type: phandle-array
    required: true
    description: GPIO for system active led

  debug-gpios:
    type: phandle-array
    required: true
    description: GPIO for debug led

  error-gpios:
    type: phandle-array
    required: true
    description: GPIO for error led
```

## software/boards/battery_management_system/Kconfig.battery_management_system
```kconfig
# SPDX-License-Identifier: Apache-2.0

config BOARD_BATTERY_MANAGEMENT_SYSTEM
	select SOC_STM32L071XX
```

## software/boards/battery_management_system/battery_management_system_defconfig
```kconfig
# SPDX-License-Identifier: Apache-2.0

# hardware configuration
CONFIG_SYS_CLOCK_HW_CYCLES_PER_SEC=80000000

# periphery drivers
CONFIG_GPIO=y
CONFIG_SERIAL=y

# operating system
CONFIG_HW_STACK_PROTECTION=y
CONFIG_CONSOLE=y
CONFIG_UART_CONSOLE=y
CONFIG_CLOCK_CONTROL=y
CONFIG_PINCTRL=y
CONFIG_USE_DT_CODE_PARTITION=y
CONFIG_PICOLIBC=y
CONFIG_DEBUG_THREAD_INFO=y
CONFIG_INIT_STACKS=y
```
