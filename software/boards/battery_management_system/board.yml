## software/boards/battery_management_system/board.yml
```yaml
board:
  name: battery_management_system
  vendor: benediktibk
  socs:
    - name: stm32l071xx
  revision:
    format: number
    default: "3"
    revisions:
    - name: "1"
    - name: "2"
    - name: "3"
```
